## CMakeLists.txt
```
#
# Copyright (c) 2018 Nordic Semiconductor
#
# SPDX-License-Identifier: LicenseRef-Nordic-5-Clause
#
cmake_minimum_required(VERSION 3.20.0)

set(PM_STATIC_YML_FILE
  ${CMAKE_CURRENT_SOURCE_DIR}/boards/pm_static_${BOARD}.yml
  )

find_package(Zephyr REQUIRED HINTS $ENV{ZEPHYR_BASE})
project(NONE)


# NORDIC SDK APP START
target_sources(app PRIVATE src/main.c)
target_sources(app PRIVATE src/spatch_ecg.c)
target_sources(app PRIVATE src/spatch_hr.c)
target_sources(app PRIVATE src/spatch_battery.c)

# NORDIC SDK APP END
zephyr_library_include_directories(.)
```

## prj.conf
```kconfig
#
# Copyright (c) 2018 Nordic Semiconductor
#
# SPDX-License-Identifier: LicenseRef-Nordic-5-Clause
#
CONFIG_BT=y
CONFIG_BT_DEBUG_LOG=y
CONFIG_BT_PERIPHERAL=y
CONFIG_BT_CENTRAL=n
CONFIG_BT_DEVICE_NAME="S-Patch zephyr"
CONFIG_BT_HRS=y
CONFIG_BT_BAS=y

# Enable the ECG service
CONFIG_DK_LIBRARY=y

CONFIG_SYSTEM_WORKQUEUE_STACK_SIZE=4096

# Enable mcumgr.
CONFIG_MCUMGR=y
CONFIG_MCUMGR_CMD_IMG_MGMT=y
CONFIG_MCUMGR_CMD_OS_MGMT=y
CONFIG_MCUMGR_SMP_BT=y
CONFIG_MCUMGR_SMP_BT_AUTHEN=n
CONFIG_IMG_ERASE_PROGRESSIVELY=y
CONFIG_IMG_MANAGER=y
CONFIG_MCUBOOT_IMG_MANAGER=y

# Ensure an MCUboot-compatible binary is generated.
CONFIG_BOOTLOADER_MCUBOOT=y
CONFIG_FW_INFO=y
CONFIG_MCUBOOT_IMAGE_VERSION="0.0.1"

# Allow for large Bluetooth data packets.
CONFIG_BT_L2CAP_TX_MTU=252
CONFIG_BT_BUF_ACL_RX_SIZE=256
```

## src/main.c
```c
/*
 * Copyright (c) 2018 Nordic Semiconductor ASA
 *
 * SPDX-License-Identifier: LicenseRef-Nordic-5-Clause
 */

#include <drivers/gpio.h>
#include <errno.h>
#include <soc.h>
#include <stddef.h>
#include <string.h>
#include <sys/byteorder.h>
#include <sys/printk.h>
#include <zephyr.h>
#include <zephyr/types.h>

#include "img_mgmt/img_mgmt.h"
#include "os_mgmt/os_mgmt.h"
#include <mgmt/mcumgr/smp_bt.h>

#include "spatch_ecg.h"
#include "spatch_hr.h"
#include "spatch_battery.h"

#include <bluetooth/bluetooth.h>
#include <bluetooth/conn.h>
#include <bluetooth/gatt.h>
#include <bluetooth/hci.h>
#include <bluetooth/uuid.h>
#include <settings/settings.h>

#include <dk_buttons_and_leds.h>

#define DEVICE_NAME CONFIG_BT_DEVICE_NAME
#define DEVICE_NAME_LEN (sizeof(DEVICE_NAME) - 1)

#define RUN_STATUS_LED DK_LED1
#define CON_STATUS_LED DK_LED2
#define RUN_LED_BLINK_INTERVAL 1000

#define USER_LED DK_LED3

#define USER_BUTTON DK_BTN1_MSK

static uint8_t app_live_state;
static uint8_t app_db_state;
static uint8_t app_motion_state;

static const struct bt_data ad[] = {
    BT_DATA_BYTES(BT_DATA_FLAGS, (BT_LE_AD_GENERAL | BT_LE_AD_NO_BREDR)),
    BT_DATA(BT_DATA_NAME_COMPLETE, DEVICE_NAME, DEVICE_NAME_LEN),
};

static const struct bt_data sd[] = {
    BT_DATA_BYTES(BT_DATA_UUID128_ALL, 0x84, 0xaa, 0x60, 0x74, 0x52, 0x8a, 0x8b,
                  0x86, 0xd3, 0x4c, 0xb7, 0x1d, 0x1d, 0xdc, 0x53, 0x8d),
};

static void connected(struct bt_conn *conn, uint8_t err) {
  if (err) {
    printk("Connection failed (err %u)\n", err);
    return;
  }

  printk("Connected\n");

  dk_set_led_on(CON_STATUS_LED);
}

static void disconnected(struct bt_conn *conn, uint8_t reason) {
  printk("Disconnected (reason %u)\n", reason);

  dk_set_led_off(CON_STATUS_LED);
}

static void security_changed(struct bt_conn *conn, bt_security_t level,
                             enum bt_security_err err) {
  char addr[BT_ADDR_LE_STR_LEN];

  bt_addr_le_to_str(bt_conn_get_dst(conn), addr, sizeof(addr));

  if (!err) {
    printk("Security changed: %s level %u\n", addr, level);
  } else {
    printk("Security failed: %s level %u err %d\n", addr, level, err);
  }
}

BT_CONN_CB_DEFINE(conn_callbacks) = {
    .connected = connected,
    .disconnected = disconnected,
    .security_changed = security_changed,
};

static void auth_passkey_display(struct bt_conn *conn, unsigned int passkey) {
  char addr[BT_ADDR_LE_STR_LEN];

  bt_addr_le_to_str(bt_conn_get_dst(conn), addr, sizeof(addr));

  printk("Passkey for %s: %06u\n", addr, passkey);
}

static void auth_cancel(struct bt_conn *conn) {
  char addr[BT_ADDR_LE_STR_LEN];

  bt_addr_le_to_str(bt_conn_get_dst(conn), addr, sizeof(addr));

  printk("Pairing cancelled: %s\n", addr);
}

static void pairing_complete(struct bt_conn *conn, bool bonded) {
  char addr[BT_ADDR_LE_STR_LEN];

  bt_addr_le_to_str(bt_conn_get_dst(conn), addr, sizeof(addr));

  printk("Pairing completed: %s, bonded: %d\n", addr, bonded);
}

static void pairing_failed(struct bt_conn *conn, enum bt_security_err reason) {
  char addr[BT_ADDR_LE_STR_LEN];

  bt_addr_le_to_str(bt_conn_get_dst(conn), addr, sizeof(addr));

  printk("Pairing failed conn: %s, reason %d\n", addr, reason);
}

static struct bt_conn_auth_cb conn_auth_callbacks = {
    .passkey_display = auth_passkey_display,
    .cancel = auth_cancel,
    .pairing_complete = pairing_complete,
    .pairing_failed = pairing_failed};

static void app_led_cb(bool led_state) { dk_set_led(USER_LED, led_state); }

static uint8_t app_live_cb(void) { return app_live_state; }

static uint8_t app_db_cb(void) { return app_db_state; }

static uint8_t app_motion_cb(void) { return app_motion_state; }

static struct bt_ECG_cb ECG_callbacs = {
    .led_cb = app_led_cb,
    .live_data_cb = app_live_cb,
    .db_data_cb = app_db_cb,
    .motion_data_cb = app_motion_cb,
};

static void button_changed(uint32_t button_state, uint32_t has_changed) {
  if (has_changed & USER_BUTTON) {
    uint8_t user_button_state = button_state & USER_BUTTON;

    bt_ECG_send_live_data(user_button_state + 1);
    bt_ECG_send_db_data(user_button_state + 2);
    bt_ECG_send_motion_data(user_button_state + 3);
    
    app_live_state = user_button_state;
    app_db_state = user_button_state;
    app_motion_state = user_button_state;
  }
}

static int init_button(void) {
  int err;

  err = dk_buttons_init(button_changed);
  if (err) {
    printk("Cannot init buttons (err: %d)\n", err);
  }

  return err;
}

void main(void) {
  printk("build time: " __DATE__ " " __TIME__ "\n");
  os_mgmt_register_group();
  img_mgmt_register_group();
  smp_bt_register();

  int blink_status = 0;
  int err;

  printk("Starting Bluetooth Peripheral ECG example\n");

  err = dk_leds_init();
  if (err) {
    printk("LEDs init failed (err %d)\n", err);
    return;
  }

  err = init_button();
  if (err) {
    printk("Button init failed (err %d)\n", err);
    return;
  }

  //if (IS_ENABLED(CONFIG_BT_ECG_SECURITY_ENABLED)) {
    bt_conn_auth_cb_register(&conn_auth_callbacks);
  //}

  err = bt_enable(NULL);
  if (err) {
    printk("Bluetooth init failed (err %d)\n", err);
    return;
  }

  printk("Bluetooth initialized\n");

  if (IS_ENABLED(CONFIG_SETTINGS)) {
    settings_load();
  }

  err = bt_ECG_init(&ECG_callbacs);
  if (err) {
    printk("Failed to init ECG (err:%d)\n", err);
    return;
  }

  err = bt_le_adv_start(BT_LE_ADV_CONN, ad, ARRAY_SIZE(ad), sd, ARRAY_SIZE(sd));
  if (err) {
    printk("Advertising failed to start (err %d)\n", err);
    return;
  }

  printk("Advertising successfully started\n");

  for (;;) {
    dk_set_led(RUN_STATUS_LED, (++blink_status) % 2);
    k_sleep(K_MSEC(RUN_LED_BLINK_INTERVAL));

    hrs_notify();
    bas_notify();
  }
}
```

## src/spatch_battery.c
```c
/*
 * Copyright (c) 2020 Nordic Semiconductor ASA
 *
 * SPDX-License-Identifier: LicenseRef-Nordic-5-Clause
 */

/** @file
 *  @brief Peripheral Heart Rate over LE Coded PHY sample
 */

#include <errno.h>
#include <stddef.h>
#include <string.h>
#include <sys/printk.h>
#include <zephyr.h>
#include <zephyr/types.h>

#include <bluetooth/bluetooth.h>
#include <bluetooth/conn.h>
#include <bluetooth/gatt.h>
#include <bluetooth/services/hrs.h>
#include <bluetooth/services/bas.h>
#include <bluetooth/uuid.h>

#include "spatch_battery.h"

void bas_notify(void) {
  uint8_t battery_level = bt_bas_get_battery_level();

  battery_level--;

  if (!battery_level) {
    battery_level = 100U;
  }

  bt_bas_set_battery_level(battery_level);
}
```

## src/spatch_battery.h
```c
/*
 * Copyright (c) 2018 Nordic Semiconductor ASA
 *
 * SPDX-License-Identifier: LicenseRef-Nordic-5-Clause
 */

#ifndef BT_SPATCH_BATTERY_H_
#define BT_SPATCH_BATTERY_H_

void bas_notify(void);

#endif /* BT_SPATCH_BATTERY_H_ */
```

## src/spatch_ecg.c
```c
/*
 * Copyright (c) 2018 Nordic Semiconductor ASA
 *
 * SPDX-License-Identifier: LicenseRef-Nordic-5-Clause
 */

/** @file
 *  @brief LED Button Service (ECG) sample
 */

#include <errno.h>
#include <stddef.h>
#include <string.h>
#include <sys/byteorder.h>
#include <sys/printk.h>
#include <zephyr.h>
#include <zephyr/types.h>

#include <bluetooth/bluetooth.h>
#include <bluetooth/conn.h>
#include <bluetooth/gatt.h>
#include <bluetooth/hci.h>
#include <bluetooth/uuid.h>

#include "spatch_ecg.h"

#include <logging/log.h>

LOG_MODULE_REGISTER(bt_ECG, LOG_LEVEL_DBG);

static bool cp_indicate_enabled;
static bool live_notify_enabled, db_notify_enabled, motion_notify_enabled;
static uint8_t db_data, live_data, motion_data;
static struct bt_ECG_cb ECG_cb;

static void ECG_cp_ccc_cfg_changed(const struct bt_gatt_attr *attr,
                                   uint16_t value) {
  cp_indicate_enabled = (value == BT_GATT_CCC_INDICATE);
  LOG_DBG("%s",
          cp_indicate_enabled ? "cp indicate enabled" : "cp indicate disabled");
}

static void ECG_live_ccc_cfg_changed(const struct bt_gatt_attr *attr,
                                     uint16_t value) {
  live_notify_enabled = (value == BT_GATT_CCC_NOTIFY);
  LOG_DBG("%s", live_notify_enabled ? "live notificate enabled"
                                    : "live notificate disabled");
}

static void ECG_db_ccc_cfg_changed(const struct bt_gatt_attr *attr,
                                   uint16_t value) {
  db_notify_enabled = (value == BT_GATT_CCC_NOTIFY);
  LOG_DBG("%s", db_notify_enabled ? "db notificate enabled"
                                  : "db notificate disabled");
}

static void ECG_motion_ccc_cfg_changed(const struct bt_gatt_attr *attr,
                                       uint16_t value) {
  motion_notify_enabled = (value == BT_GATT_CCC_NOTIFY);
  LOG_DBG("%s", motion_notify_enabled ? "motion notificate enabled"
                                      : "motion notificate disabled");
}

static ssize_t write_led(struct bt_conn *conn, const struct bt_gatt_attr *attr,
                         const void *buf, uint16_t len, uint16_t offset,
                         uint8_t flags) {
  LOG_DBG("Attribute write, handle: %u, conn: %p", attr->handle, (void *)conn);

  if (len != 1U) {
    LOG_DBG("Write led: Incorrect data length%s", "");
    return BT_GATT_ERR(BT_ATT_ERR_INVALID_ATTRIBUTE_LEN);
  }

  if (offset != 0) {
    LOG_DBG("Write led: Incorrect data offset%s", "");
    return BT_GATT_ERR(BT_ATT_ERR_INVALID_OFFSET);
  }

  if (ECG_cb.led_cb) {
    uint8_t val = *((uint8_t *)buf);

    if (val == 0x00 || val == 0x01) {
      ECG_cb.led_cb(val ? true : false);
    } else {
      LOG_DBG("Write led: Incorrect value%s", "");
      return BT_GATT_ERR(BT_ATT_ERR_VALUE_NOT_ALLOWED);
    }
  }

  return len;
}

static ssize_t read_live(struct bt_conn *conn, const struct bt_gatt_attr *attr,
                         void *buf, uint16_t len, uint16_t offset) {
  const char *value = attr->user_data;

  LOG_DBG("Attribute read, handle: %u, conn: %p", attr->handle, (void *)conn);

  if (ECG_cb.live_data_cb) {
    live_data = ECG_cb.live_data_cb();
    return bt_gatt_attr_read(conn, attr, buf, len, offset, value,
                             sizeof(*value));
  }

  return 0;
}

static ssize_t read_db(struct bt_conn *conn, const struct bt_gatt_attr *attr,
                       void *buf, uint16_t len, uint16_t offset) {
  const char *value = attr->user_data;

  LOG_DBG("Attribute read, handle: %u, conn: %p", attr->handle, (void *)conn);

  if (ECG_cb.db_data_cb) {
    db_data = ECG_cb.db_data_cb();
    return bt_gatt_attr_read(conn, attr, buf, len, offset, value,
                             sizeof(*value));
  }

  return 0;
}

static ssize_t read_motion(struct bt_conn *conn,
                           const struct bt_gatt_attr *attr, void *buf,
                           uint16_t len, uint16_t offset) {
  const char *value = attr->user_data;

  LOG_DBG("Attribute read, handle: %u, conn: %p", attr->handle, (void *)conn);

  if (ECG_cb.motion_data_cb) {
    motion_data = ECG_cb.motion_data_cb();
    return bt_gatt_attr_read(conn, attr, buf, len, offset, value,
                             sizeof(*value));
  }

  return 0;
}

/* LED Button Service Declaration */
BT_GATT_SERVICE_DEFINE(
    ECG_svc, BT_GATT_PRIMARY_SERVICE(BT_UUID_ECG),
    BT_GATT_CHARACTERISTIC(BT_UUID_ECG_CONTROL_POINTER,
                           BT_GATT_CHRC_WRITE | BT_GATT_CHRC_INDICATE,
                           BT_GATT_PERM_WRITE | BT_GATT_PERM_READ, NULL,
                           write_led, NULL),
    BT_GATT_CCC(ECG_cp_ccc_cfg_changed, BT_GATT_PERM_READ | BT_GATT_PERM_WRITE),
    BT_GATT_CHARACTERISTIC(BT_UUID_ECG_LIVE, BT_GATT_CHRC_NOTIFY, NULL,
                           read_live, NULL, &live_data),
    BT_GATT_CCC(ECG_live_ccc_cfg_changed,
                BT_GATT_PERM_READ | BT_GATT_PERM_WRITE),
    BT_GATT_CHARACTERISTIC(BT_UUID_ECG_DB, BT_GATT_CHRC_NOTIFY, NULL, read_db,
                           NULL, &db_data),
    BT_GATT_CCC(ECG_db_ccc_cfg_changed, BT_GATT_PERM_READ | BT_GATT_PERM_WRITE),
    BT_GATT_CHARACTERISTIC(BT_UUID_ECG_MOTION, BT_GATT_CHRC_NOTIFY, NULL,
                           read_motion, NULL, &motion_data),
    BT_GATT_CCC(ECG_motion_ccc_cfg_changed,
                BT_GATT_PERM_READ | BT_GATT_PERM_WRITE), );

int bt_ECG_init(struct bt_ECG_cb *callbacks) {
  if (callbacks) {
    ECG_cb.led_cb = callbacks->led_cb;
    ECG_cb.live_data_cb = callbacks->live_data_cb;
    ECG_cb.db_data_cb = callbacks->db_data_cb;
    ECG_cb.motion_data_cb = callbacks->motion_data_cb;
  }

  return 0;
}

int bt_ECG_send_live_data(uint8_t live_data) {
  if (!live_notify_enabled) {
    return -EACCES;
  }

  return bt_gatt_notify(NULL, &ECG_svc.attrs[5], &live_data, sizeof(live_data));
}

int bt_ECG_send_db_data(uint8_t db_data) {
  if (!db_notify_enabled) {
    return -EACCES;
  }

  return bt_gatt_notify(NULL, &ECG_svc.attrs[8], &db_data, sizeof(db_data));
}

int bt_ECG_send_motion_data(uint8_t motion_data) {
  if (!motion_notify_enabled) {
    return -EACCES;
  }

  return bt_gatt_notify(NULL, &ECG_svc.attrs[11], &motion_data,
                        sizeof(motion_data));
}
```

## src/spatch_ecg.h
```c
/*
 * Copyright (c) 2018 Nordic Semiconductor ASA
 *
 * SPDX-License-Identifier: LicenseRef-Nordic-5-Clause
 */

#ifndef BT_SPATCH_ECG_H_
#define BT_SPATCH_ECG_H_

/**@file
 * @defgroup bt_ECG LED Button Service API
 * @{
 * @brief API for the LED Button Service (ECG).
 */

#ifdef __cplusplus
extern "C" {
#endif

#include <zephyr/types.h>

/** @brief ECG Service UUID. */
#define BT_UUID_ECG_VAL                                                        \
  BT_UUID_128_ENCODE(0x66900001, 0xDA64, 0x5A97, 0x8C4F, 0x04B8593FF99B)

/** @brief ECG Control Pointer Characteristic UUID. */
#define BT_UUID_ECG_CONTROL_POINTER_VAL                                        \
  BT_UUID_128_ENCODE(0x66900002, 0xDA64, 0x5A97, 0x8C4F, 0x04B8593FF99B)

/** @brief ECG Live Characteristic UUID. */
#define BT_UUID_ECG_LIVE_VAL                                                   \
  BT_UUID_128_ENCODE(0x66900003, 0xDA64, 0x5A97, 0x8C4F, 0x04B8593FF99B)

/** @brief ECG DB Characteristic UUID. */
#define BT_UUID_DB_LIVE_VAL                                                    \
  BT_UUID_128_ENCODE(0x66900005, 0xDA64, 0x5A97, 0x8C4F, 0x04B8593FF99B)

/** @brief IMU Characteristic UUID. */
#define BT_UUID_ECG_MOTION_DATA_VAL                                            \
  BT_UUID_128_ENCODE(0x66900006, 0xDA64, 0x5A97, 0x8C4F, 0x04B8593FF99B)

#define BT_UUID_ECG BT_UUID_DECLARE_128(BT_UUID_ECG_VAL)
#define BT_UUID_ECG_CONTROL_POINTER                                            \
  BT_UUID_DECLARE_128(BT_UUID_ECG_CONTROL_POINTER_VAL)
#define BT_UUID_ECG_LIVE BT_UUID_DECLARE_128(BT_UUID_ECG_LIVE_VAL)
#define BT_UUID_ECG_DB BT_UUID_DECLARE_128(BT_UUID_DB_LIVE_VAL)
#define BT_UUID_ECG_MOTION BT_UUID_DECLARE_128(BT_UUID_ECG_MOTION_DATA_VAL)

/** @brief Callback type for when an LED state change is received. */
typedef void (*led_cb_t)(const bool led_state);

/** @brief Callback type for when the button state is pulled. */
typedef uint8_t (*live_cb_t)(void);
typedef uint8_t (*db_cb_t)(void);
typedef uint8_t (*motion_cb_t)(void);

/** @brief Callback struct used by the ECG Service. */
struct bt_ECG_cb {
  /** LED state change callback. */
  led_cb_t led_cb;
  live_cb_t live_data_cb;
  db_cb_t db_data_cb;
  motion_cb_t motion_data_cb;
};

/** @brief Initialize the ECG Service.
 *
 * This function registers a GATT service with two characteristics: Button
 * and LED.
 * Send notifications for the Button Characteristic to let connected peers know
 * when the button state changes.
 * Write to the LED Characteristic to change the state of the LED on the
 * board.
 *
 * @param[in] callbacks Struct containing pointers to callback functions
 *			used by the service. This pointer can be NULL
 *			if no callback functions are defined.
 *
 *
 * @retval 0 If the operation was successful.
 *           Otherwise, a (negative) error code is returned.
 */
int bt_ECG_init(struct bt_ECG_cb *callbacks);

/** @brief Send the button state.
 *
 * This function sends a binary state, typically the state of a
 * button, to all connected peers.
 *
 * @param[in] button_state The state of the button.
 *
 * @retval 0 If the operation was successful.
 *           Otherwise, a (negative) error code is returned.
 */
int bt_ECG_send_live_data(uint8_t button_state);
int bt_ECG_send_db_data(uint8_t button_state);
int bt_ECG_send_motion_data(uint8_t button_state);

#ifdef __cplusplus
}
#endif

/**
 * @}
 */

#endif /* BT_SPATCH_ECG_H_ */
```

## src/spatch_hr.c
```c
/*
 * Copyright (c) 2020 Nordic Semiconductor ASA
 *
 * SPDX-License-Identifier: LicenseRef-Nordic-5-Clause
 */

/** @file
 *  @brief Peripheral Heart Rate over LE Coded PHY sample
 */

#include <errno.h>
#include <stddef.h>
#include <string.h>
#include <sys/printk.h>
#include <zephyr.h>
#include <zephyr/types.h>

#include <bluetooth/bluetooth.h>
#include <bluetooth/conn.h>
#include <bluetooth/gatt.h>
#include <bluetooth/services/hrs.h>
#include <bluetooth/uuid.h>

#include "spatch_hr.h"

void hrs_notify(void) {
  static uint8_t heartrate = 90U;

  /* Heartrate measurements simulation */
  heartrate++;
  if (heartrate == 160U) {
    heartrate = 90U;
  }

  bt_hrs_notify(heartrate);
}
```

## src/spatch_hr.h
```c
/*
 * Copyright (c) 2018 Nordic Semiconductor ASA
 *
 * SPDX-License-Identifier: LicenseRef-Nordic-5-Clause
 */

#ifndef BT_SPATCH_HR_H_
#define BT_SPATCH_HR_H_

void hrs_notify(void);

#endif /* BT_SPATCH_HR_H_ */
```
