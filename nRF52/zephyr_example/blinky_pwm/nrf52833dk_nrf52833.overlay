// To get started, press Ctrl+Space to bring up the completion menu and view the available nodes.
// For more help, browse the DeviceTree documentation at https: //docs.zephyrproject.org/latest/guides/dts/index.html
&pwm_led0 {
    pwms = <&pwm0 14>;
};

&pwm0 {
	ch0-pin = <14>;
};